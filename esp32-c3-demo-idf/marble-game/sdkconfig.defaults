## esp32-c3-demo-idf/marble-game/sdkconfig.defaults
```kconfig
# ESP32-C3 Configuration
CONFIG_IDF_TARGET="esp32c3"

# Flash size
CONFIG_ESPTOOLPY_FLASHSIZE_4MB=y

# Performance optimizations
CONFIG_FREERTOS_HZ=1000
CONFIG_ESP_DEFAULT_CPU_FREQ_MHZ_160=y

# Arduino component
CONFIG_ENABLE_ARDUINO_DEPENDS=y

# Disable unnecessary features to save memory
CONFIG_BT_ENABLED=n
CONFIG_LWIP_IPV6=n

# Optimization for speed
CONFIG_COMPILER_OPTIMIZATION_PERF=y

# Increase stack size for rendering
CONFIG_ESP_MAIN_TASK_STACK_SIZE=8192

# Serial monitor
CONFIG_ESP_CONSOLE_UART_DEFAULT=y
CONFIG_ESP_CONSOLE_UART_BAUDRATE=115200
```

## esp32-c3-demo-idf/neon-defender/sdkconfig.defaults
```kconfig
# NEON DEFENDER - Default Configuration

# Enable Arduino as component
CONFIG_ENABLE_ARDUINO_DEPENDS=y

# USB Serial/JTAG Console
CONFIG_ESP_CONSOLE_USB_SERIAL_JTAG=y
CONFIG_ESP_CONSOLE_SECONDARY_NONE=y

# ESP32-C3 specific
CONFIG_IDF_TARGET="esp32c3"

# Flash size
CONFIG_ESPTOOLPY_FLASHSIZE_4MB=y

# Partition table
CONFIG_PARTITION_TABLE_SINGLE_APP=y

# Bluetooth
CONFIG_BT_ENABLED=y
CONFIG_BT_BLUEDROID_ENABLED=y
CONFIG_BT_CLASSIC_ENABLED=y
CONFIG_BT_A2DP_ENABLE=y
CONFIG_BT_SPP_ENABLED=n

# WiFi (disable to save memory)
CONFIG_ESP32_WIFI_ENABLED=n

# FreeRTOS
CONFIG_FREERTOS_HZ=1000

# SPI
CONFIG_SPI_MASTER_IN_IRAM=y
CONFIG_SPI_MASTER_ISR_IN_IRAM=y

# Compiler optimization for performance
CONFIG_COMPILER_OPTIMIZATION_PERF=y

# Stack sizes
CONFIG_ESP_MAIN_TASK_STACK_SIZE=8192
CONFIG_ARDUINO_LOOP_STACK_SIZE=16384

# Serial monitor
CONFIG_ESPTOOLPY_MONITOR_BAUD_115200B=y
CONFIG_ESPTOOLPY_BAUD_921600B=y

# Enable Bluetooth coexistence
CONFIG_ESP_COEX_SW_COEXIST_ENABLE=y

# Increase Bluetooth buffer
CONFIG_BT_ACL_CONNECTIONS=4
```

## esp32-c3-demo-idf/sdkconfig.defaults
```kconfig
# ESP32-C3 Round Display Demo - Default Configuration

# Enable Arduino as component
CONFIG_ENABLE_ARDUINO_DEPENDS=y

# USB Serial/JTAG Console
CONFIG_ESP_CONSOLE_USB_SERIAL_JTAG=y
CONFIG_ESP_CONSOLE_SECONDARY_NONE=y

# ESP32-C3 specific
CONFIG_IDF_TARGET="esp32c3"

# Flash size
CONFIG_ESPTOOLPY_FLASHSIZE_4MB=y

# Partition table
CONFIG_PARTITION_TABLE_SINGLE_APP=y

# FreeRTOS
CONFIG_FREERTOS_HZ=1000

# WiFi
CONFIG_ESP32_WIFI_STATIC_RX_BUFFER_NUM=10
CONFIG_ESP32_WIFI_DYNAMIC_RX_BUFFER_NUM=32
CONFIG_ESP32_WIFI_DYNAMIC_TX_BUFFER_NUM=32

# SPI
CONFIG_SPI_MASTER_IN_IRAM=y
CONFIG_SPI_MASTER_ISR_IN_IRAM=y

# Compiler optimization
CONFIG_COMPILER_OPTIMIZATION_PERF=y

# Stack sizes
CONFIG_ESP_MAIN_TASK_STACK_SIZE=8192

# Serial monitor
CONFIG_ESPTOOLPY_MONITOR_BAUD_115200B=y
CONFIG_ESPTOOLPY_BAUD_921600B=y
```

## esp32-c3-demo-idf/synesthesia/sdkconfig.defaults
```kconfig
# ESP32-C3 Configuration for Synesthesia
CONFIG_IDF_TARGET="esp32c3"

# Flash size
CONFIG_ESPTOOLPY_FLASHSIZE_4MB=y

# Performance optimizations
CONFIG_FREERTOS_HZ=1000
CONFIG_ESP_DEFAULT_CPU_FREQ_MHZ_160=y

# Arduino component
CONFIG_ENABLE_ARDUINO_DEPENDS=y

# Disable unnecessary features
CONFIG_BT_ENABLED=n
CONFIG_LWIP_IPV6=n

# Optimization for performance
CONFIG_COMPILER_OPTIMIZATION_PERF=y

# Larger stack for audio/visual processing
CONFIG_ESP_MAIN_TASK_STACK_SIZE=12288

# Enable hardware timer
CONFIG_ESP_TIMER_TASK_STACK_SIZE=4096

# Serial monitor
CONFIG_ESP_CONSOLE_UART_DEFAULT=y
CONFIG_ESP_CONSOLE_UART_BAUDRATE=115200
```
